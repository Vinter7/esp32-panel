#include <WiFi.h>
#include <HTTPClient.h>
#include <ArduinoJson.h>
#include <Adafruit_GFX.h>
#include <Adafruit_ST7735.h>
#include "AudioTools.h"
#include "BluetoothA2DPSink.h"
#include <Fonts/FreeSans9pt7b.h>

AnalogAudioStream out;
BluetoothA2DPSink a2dp_sink(out);

const char *ssid = "wifi name";
const char *passwd = "wifi password";
const char *infoUrl = "http://192.168.1.1:8000/";
HTTPClient http;
StaticJsonDocument<200> jsonDoc;
Adafruit_ST7735 tft = Adafruit_ST7735(5, 2, 4);
bool first = true;



void setup() {
  a2dp_sink.start("MyMusic");
  // put your setup code here, to run once:
  Serial.begin(115200);
  WiFi.disconnect();
  Serial.println("connect wifi");
  WiFi.begin(ssid, passwd);
  while (WiFi.status() != WL_CONNECTED) {
    delay(500);
    Serial.print(".");
  }
  Serial.println(WiFi.localIP());
  tft.initR(INITR_BLACKTAB);
  tft.fillScreen(ST77XX_BLACK);
  tft.setRotation(1);
  tft.fillRect(0, 0, 160, 15, ST77XX_BLUE);


  tft.setTextWrap(false);
  
}

void loop() {
  http.begin(infoUrl);
  int httpCode = http.GET();

  // 检查HTTP响应状态码
  if (httpCode > 0) {
    // HTTP请求成功，处理响应数据
    // String response = http.getString();
    auto err = deserializeJson(jsonDoc, http.getString());
    if (err) {
      Serial.print("deserializeJson() failed");
      return;
    }
    bool recognize = jsonDoc["recognize"];
    if (!recognize) {
      Serial.print("get error");
      return;
    }
    String systemName = jsonDoc["systemName"];
    String ip = jsonDoc["ip"];
    String cpuName = jsonDoc["cpuName"];
    // String cpuCores = jsonDoc["cpuCores"];
    String cpuFreq = jsonDoc["cpuFreq"];
    String cpuPercent = jsonDoc["cpuPercent"];
    String gpuName = jsonDoc["gpuName"];
    String gpuTemp = jsonDoc["gpuTemp"];
    // String gpuMemPercent = jsonDoc["gpuMemPercent"];
    String gpuPercent = jsonDoc["gpuPercent"];
    String memUsed = jsonDoc["memUsed"];
    String memTotal = jsonDoc["memTotal"];
    String memPercent = jsonDoc["memPercent"];
    String send = jsonDoc["send"];
    String recv = jsonDoc["recv"];
    // Serial.println(systemName);
    if (first) {
      tft.setTextColor(ST77XX_WHITE);
      tft.setCursor(4, 4);
      tft.print(systemName + ": " + ip);
      const uint8_t amd[] = { 0x7F, 0xFF, 0xFF, 0xFF, 0x3F, 0xFF, 0xFF, 0xFF, 0x1F, 0xFF, 0xFF, 0xFF, 0x0F,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 0xE0, 0x00 };
      const uint8_t nvidia[] = { 0x00, 0x00, 0x00, 0x00, 0x00, 0x00, 0x00, 0x00, 0x00, 0x00, 0x00, 0x00, 0x00,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 0x00, 0x00 };

      if (strstr(cpuName.c_str(), "AMD"))
        tft.drawBitmap(8, 32, amd, 32, 32, ST77XX_RED);
      else {
        tft.setTextColor(ST77XX_BLUE);
        tft.setTextSize(1, 2);
        tft.setCursor(8, 40);
        tft.print("intel");
      }

      if (strstr(gpuName.c_str(), "NVIDIA"))
        tft.drawBitmap(8, 84, nvidia, 32, 32, ST77XX_GREEN);
      else
        tft.drawBitmap(8, 84, amd, 32, 32, ST77XX_RED);

      tft.setTextColor(ST77XX_WHITE);
      first  = false;
    }
    tft.setFont(&FreeSans9pt7b);

    tft.fillRect(48, 16, 150, 150, ST77XX_BLACK);

    tft.setCursor(48, 40);
    tft.print(cpuFreq + " " + cpuPercent);
    tft.setCursor(48, 64);
    tft.print("^" + send + " " + recv);

    tft.setCursor(48, 96);
    tft.print(gpuTemp + " " + gpuPercent);
    tft.setCursor(48, 120);
    tft.print(memUsed + " " + memPercent);

  } else {
    // HTTP请求失败，打印错误信息
    Serial.print("Error code: ");
    Serial.println(httpCode);
  }
  http.end();
  delay(5000);
}
